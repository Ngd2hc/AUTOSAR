AUTOSAR XML (schema 4-0-3)
package /OS_CFG
  module config Os
    RTE_RESOURCE (OsResource): OsResourceProperty=STANDARD
    3 x OsTask, all with OsTaskSchedule=FULL, OsTaskResourceRef=RTE_RESOURCE:
      OsTask_TE: OsTaskActivation=1, OsTaskPriority=1
      OsTask_OIE: OsTaskActivation=2, OsTaskPriority=2
      OsTask_2: OsTaskActivation=2, OsTaskPriority=3
    Rte_TickCounter (OsCounter): OsCounterMaxAllowedValue=65535, OsCounterMinCycle=1, OsCounterTicksPerBase=1, OsCounterType=SOFTWARE
    Rte_ScheduleTable (OsScheduleTable): OsScheduleTableRepeating=true, OsScheduleTableDuration=1, OsScheduleTableCounterRef=Rte_TickCounter
      rte_Stimulus_1 (OsScheduleTableExpiryPoint): OsScheduleTblExpPointOffset=0
        TaskActivation1 (OsScheduleTableTaskActivation): OsScheduleTableActivateTaskRef=OsTask_TE
    Rte_TOutCounter (OsCounter): OsCounterMaxAllowedValue=65535, OsCounterMinCycle=1, OsCounterTicksPerBase=1, OsCounterType=SOFTWARE
    Rte_TimeoutAlarm1 (OsAlarm): OsAlarmCounterRef=Rte_TOutCounter
      Action (OsAlarmAction)
        Callback (OsAlarmCallback): OsAlarmCallbackName=Rte_NullAlarmCallback
