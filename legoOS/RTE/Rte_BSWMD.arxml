AUTOSAR XML (schema 4-0-2)
standard types defined: uint8
package /AUTOSAR_Rte/BswModuleDescriptions
  bsw module description RteBswModuleDescription: provided-entrys=[Rte_Start, Rte_Stop, SchM_DeInit, SchM_Init]
    bsw module dependency ModDepOS: target-module-id=001
      required-entrys:
        ActivateTask
        CancelAlarm
        ClearEvent
        GetEvent
        GetResource
        GetTaskID
        ReleaseResource
        ResumeOSInterrupts
        SetEvent
        SetRelAlarm
        SuspendOSInterrupts
        TerminateTask
        WaitEvent
    bsw internal behavior RteInternalBehavior
      constant-memorys:
        10 x parameter data prototype:
          Rte_Inst_ECU_ABS: type=Rte_CDS_ECU_ABS
          Rte_Inst_Sensor_comp: type=Rte_CDS_Sensor_comp
          Rte_Inst_Status_printf: type=Rte_CDS_Status_printf
          Rte_Queue_CPT_ECU_ABS_P_toSensor_cs_toSensor: type=Rte_QTaskType
          Rte_Queue_CPT_Sensor_comp_R_Sensor_comp_cs_toSensor: type=Rte_QDRAType
          Rte_Self_CPT_ECU_ABS: type=Rte_SelfType_ECU_ABS
          Rte_Self_CPT_Sensor_comp: type=Rte_SelfType_Sensor_comp
          Rte_Self_CPT_Status_printf: type=Rte_SelfType_Status_printf
          Rte_Tasks: type=Rte_TaskInfo
          Rte_TimeoutAlarms: type=Rte_AlarmRefType
      static-memorys:
        7 x data:
          Rte_ActCount_CPT_Status_printf_DRE_event: type=Rte_REActCounterType
          Rte_Queue_CPT_ECU_ABS_P_toSensor_cs_toSensor_data: type=Rte_CPT_ECU_ABS_P_toSensor_cs_toSensor_QEType
          Rte_Queue_CPT_ECU_ABS_P_toSensor_cs_toSensor_dyn: type=Rte_QDynType
          Rte_Queue_CPT_Sensor_comp_R_Sensor_comp_cs_toSensor_data: type=Rte_CPT_ECU_ABS_P_toSensor_cs_toSensor_RtnQEType
          Rte_Queue_CPT_Sensor_comp_R_Sensor_comp_cs_toSensor_dynamic: type=Rte_QDynType
          Rte_Var_CPT_Sensor_comp_R_Sensor_comp_cs_toSensor_outstanding: type=uint8
          sr_toStatus: type=uint8
      4 x bsw called entity:
        BCERte_Start: implemented-entry=Rte_Start
        BCERte_Stop: implemented-entry=Rte_Stop
        BCESchM_DeInit: implemented-entry=SchM_DeInit
        BCESchM_Init: implemented-entry=SchM_Init
package /AUTOSAR_Rte/BswModuleEntrys
  4 x bsw module entry:
    Rte_Start
    Rte_Stop
    SchM_DeInit
    SchM_Init
package /AUTOSAR_Rte/BswImplementations
  bsw implementation Rte: programming-language=C, sw-version=0.0.0, used-code-generator=ETAS RTEGen, ar-release-version=4.0.0, behavior=RteInternalBehavior
    generated-artifacts:
      34 x dependency on artifact:
        Com_h: artifact-descriptor={short-label=Com_h, category=SWHDR, domain=AUTOSAR}
        ECU_ABS_MemMap_h: artifact-descriptor={short-label=ECU_ABS_MemMap_h, category=SWHDR, domain=AUTOSAR}
        Ioc_h: artifact-descriptor={short-label=Ioc_h, category=SWHDR, domain=AUTOSAR}
        MemMap_h: artifact-descriptor={short-label=MemMap_h, category=SWHDR, domain=AUTOSAR}
        NvM_h: artifact-descriptor={short-label=NvM_h, category=SWHDR, domain=AUTOSAR}
        Os_h: artifact-descriptor={short-label=Os_h, category=SWHDR, domain=AUTOSAR}
        OsTask_2_c: artifact-descriptor={short-label=OsTask_2_c, category=SWSRC, domain=AUTOSAR}
        OsTask_2_h: artifact-descriptor={short-label=OsTask_2_h, category=SWHDR, domain=AUTOSAR}
        OsTask_OIE_c: artifact-descriptor={short-label=OsTask_OIE_c, category=SWSRC, domain=AUTOSAR}
        OsTask_OIE_h: artifact-descriptor={short-label=OsTask_OIE_h, category=SWHDR, domain=AUTOSAR}
        OsTask_TE_c: artifact-descriptor={short-label=OsTask_TE_c, category=SWSRC, domain=AUTOSAR}
        OsTask_TE_h: artifact-descriptor={short-label=OsTask_TE_h, category=SWHDR, domain=AUTOSAR}
        Rte_c: artifact-descriptor={short-label=Rte_c, category=SWSRC, domain=AUTOSAR}
        Rte_h: artifact-descriptor={short-label=Rte_h, category=SWHDR, domain=AUTOSAR}
        Rte_Cbk_h: artifact-descriptor={short-label=Rte_Cbk_h, category=SWHDR, domain=AUTOSAR}
        Rte_Cfg_h: artifact-descriptor={short-label=Rte_Cfg_h, category=SWHDR, domain=AUTOSAR}
        Rte_Const_h: artifact-descriptor={short-label=Rte_Const_h, category=SWHDR, domain=AUTOSAR}
        Rte_DataHandleType_h: artifact-descriptor={short-label=Rte_DataHandleType_h, category=SWHDR, domain=AUTOSAR}
        Rte_ECU_ABS_c: artifact-descriptor={short-label=Rte_ECU_ABS_c, category=SWSRC, domain=AUTOSAR}
        Rte_ECU_ABS_h: artifact-descriptor={short-label=Rte_ECU_ABS_h, category=SWHDR, domain=AUTOSAR}
        Rte_ECU_ABS_Type_h: artifact-descriptor={short-label=Rte_ECU_ABS_Type_h, category=SWHDR, domain=AUTOSAR}
        Rte_Hook_h: artifact-descriptor={short-label=Rte_Hook_h, category=SWHDR, domain=AUTOSAR}
        Rte_Intl_h: artifact-descriptor={short-label=Rte_Intl_h, category=SWHDR, domain=AUTOSAR}
        Rte_Lib_c: artifact-descriptor={short-label=Rte_Lib_c, category=SWSRC, domain=AUTOSAR}
        Rte_Main_h: artifact-descriptor={short-label=Rte_Main_h, category=SWHDR, domain=AUTOSAR}
        Rte_Sensor_comp_c: artifact-descriptor={short-label=Rte_Sensor_comp_c, category=SWSRC, domain=AUTOSAR}
        Rte_Sensor_comp_h: artifact-descriptor={short-label=Rte_Sensor_comp_h, category=SWHDR, domain=AUTOSAR}
        Rte_Sensor_comp_Type_h: artifact-descriptor={short-label=Rte_Sensor_comp_Type_h, category=SWHDR, domain=AUTOSAR}
        Rte_Status_printf_c: artifact-descriptor={short-label=Rte_Status_printf_c, category=SWSRC, domain=AUTOSAR}
        Rte_Status_printf_h: artifact-descriptor={short-label=Rte_Status_printf_h, category=SWHDR, domain=AUTOSAR}
        Rte_Status_printf_Type_h: artifact-descriptor={short-label=Rte_Status_printf_Type_h, category=SWHDR, domain=AUTOSAR}
        Rte_Type_h: artifact-descriptor={short-label=Rte_Type_h, category=SWHDR, domain=AUTOSAR}
        Sensor_comp_MemMap_h: artifact-descriptor={short-label=Sensor_comp_MemMap_h, category=SWHDR, domain=AUTOSAR}
        Status_printf_MemMap_h: artifact-descriptor={short-label=Status_printf_MemMap_h, category=SWHDR, domain=AUTOSAR}
    resource consumption ResConsumption
      5 x memory section:
        CODE: alignment=UNSPECIFIED, sw-addrmethod=CODE
        CONST_UNSPECIFIED: alignment=UNSPECIFIED, sw-addrmethod=CONST_UNSPECIFIED
        TASKBODY: alignment=UNSPECIFIED, sw-addrmethod=TASKBODY
        VAR_8BIT: alignment=8, sw-addrmethod=VAR_8BIT
        VAR_UNSPECIFIED: alignment=UNSPECIFIED, sw-addrmethod=VAR_UNSPECIFIED
package /AUTOSAR_Rte/DataConstrs
  range DataConstraints_DataConstr_uint8: phys 0..255, raw 0..255
package /AUTOSAR_Rte/ImplementationDataTypes
  15 x impl type:
    Rte_REActCounterType: category=VALUE  # This is an external type, i.e. it is declared in the Rte Library and not in the XML. RTEGen does not have any information about this type apart from its name.
    Rte_CDS_ECU_ABS: category=STRUCTURE
      element _dummy: implementation-data-type=uint8
    Rte_CDS_Sensor_comp: category=STRUCTURE
      element _dummy: implementation-data-type=uint8
    Rte_CDS_Status_printf: category=STRUCTURE
      element _dummy: implementation-data-type=uint8
    Rte_QTaskType: category=VALUE  # This is an external type, i.e. it is declared in the Rte Library and not in the XML. RTEGen does not have any information about this type apart from its name.
    Rte_QCmnRefType: category=VALUE  # This is an external type, i.e. it is declared in the Rte Library and not in the XML. RTEGen does not have any information about this type apart from its name.
    Rte_CPT_ECU_ABS_P_toSensor_cs_toSensor_QEType: category=STRUCTURE
      element cs_data: implementation-data-type=uint8
      element clientQueue: implementation-data-type=Rte_QCmnRefType
    Rte_QDynType: category=VALUE  # This is an external type, i.e. it is declared in the Rte Library and not in the XML. RTEGen does not have any information about this type apart from its name.
    Rte_QDRAType: category=VALUE  # This is an external type, i.e. it is declared in the Rte Library and not in the XML. RTEGen does not have any information about this type apart from its name.
    Rte_CPT_ECU_ABS_P_toSensor_cs_toSensor_RtnQEType: category=STRUCTURE
      element cs_data: implementation-data-type=uint8
    Rte_SelfType_ECU_ABS: implementation-data-type=Rte_CDS_ECU_ABS
    Rte_SelfType_Sensor_comp: implementation-data-type=Rte_CDS_Sensor_comp
    Rte_SelfType_Status_printf: implementation-data-type=Rte_CDS_Status_printf
    Rte_TaskInfo: category=VALUE  # This is an external type, i.e. it is declared in the Rte Library and not in the XML. RTEGen does not have any information about this type apart from its name.
    Rte_AlarmRefType: category=VALUE  # This is an external type, i.e. it is declared in the Rte Library and not in the XML. RTEGen does not have any information about this type apart from its name.
package /AUTOSAR_Rte/SwAddrMethods
  5 x sw addr method:
    CODE: section-type=CODE
    CONST_UNSPECIFIED: section-type=CONST
    TASKBODY: section-type=CODE
    VAR_8BIT: section-type=VAR
    VAR_UNSPECIFIED: section-type=VAR
