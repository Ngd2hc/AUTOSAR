AUTOSAR XML (schema 4-0-2)
standard types defined: uint8
package /AUTOSAR_Rte/BswModuleDescriptions
  bsw module description RteBswModuleDescription: provided-entrys=[Rte_Start, Rte_Stop, SchM_DeInit, SchM_Init]
    bsw module dependency ModDepOS: target-module-id=001
      required-entrys:
        ActivateTask
        CancelAlarm
        ClearEvent
        GetEvent
        GetResource
        GetTaskID
        ReleaseResource
        ResumeOSInterrupts
        SetEvent
        SetRelAlarm
        SuspendOSInterrupts
        TerminateTask
        WaitEvent
    bsw internal behavior RteInternalBehavior
      constant-memorys:
        9 x parameter data prototype:
          Rte_Inst_App_swc1: type=Rte_CDS_App_swc1
          Rte_Inst_App_swc2: type=Rte_CDS_App_swc2
          Rte_Inst_ECU_ABS: type=Rte_CDS_ECU_ABS
          Rte_Inst_Sensor_swc: type=Rte_CDS_Sensor_swc
          Rte_Self_CPT_App_swc1: type=Rte_SelfType_App_swc1
          Rte_Self_CPT_App_swc2: type=Rte_SelfType_App_swc2
          Rte_Self_CPT_ECU_ABS: type=Rte_SelfType_ECU_ABS
          Rte_Self_CPT_Sensor_swc: type=Rte_SelfType_Sensor_swc
          Rte_Tasks: type=Rte_TaskInfo
      static-memorys:
        4 x data:
          CPT_Sensor_swc_IB_Sensor_swc_Explicit_VariableDataPrototype_0: type=uint8
          Rte_ActCount_CPT_App_swc1_ExternalTriggerOccurredEvent_0: type=Rte_REActCounterType
          Rte_ActCount_CPT_App_swc2_DataReceivedEvent_0: type=Rte_REActCounterType
          sr_test: type=uint8
      4 x bsw called entity:
        BCERte_Start: implemented-entry=Rte_Start
        BCERte_Stop: implemented-entry=Rte_Stop
        BCESchM_DeInit: implemented-entry=SchM_DeInit
        BCESchM_Init: implemented-entry=SchM_Init
package /AUTOSAR_Rte/BswModuleEntrys
  4 x bsw module entry:
    Rte_Start
    Rte_Stop
    SchM_DeInit
    SchM_Init
package /AUTOSAR_Rte/BswImplementations
  bsw implementation Rte: programming-language=C, sw-version=0.0.0, used-code-generator=ETAS RTEGen, ar-release-version=4.0.0, behavior=RteInternalBehavior
    generated-artifacts:
      33 x dependency on artifact:
        Com_h: artifact-descriptor={short-label=Com_h, category=SWHDR, domain=AUTOSAR}
        Ioc_h: artifact-descriptor={short-label=Ioc_h, category=SWHDR, domain=AUTOSAR}
        NvM_h: artifact-descriptor={short-label=NvM_h, category=SWHDR, domain=AUTOSAR}
        Os_h: artifact-descriptor={short-label=Os_h, category=SWHDR, domain=AUTOSAR}
        OsTask_100ms_c: artifact-descriptor={short-label=OsTask_100ms_c, category=SWSRC, domain=AUTOSAR}
        OsTask_100ms_h: artifact-descriptor={short-label=OsTask_100ms_h, category=SWHDR, domain=AUTOSAR}
        OsTask_10ms_c: artifact-descriptor={short-label=OsTask_10ms_c, category=SWSRC, domain=AUTOSAR}
        OsTask_10ms_h: artifact-descriptor={short-label=OsTask_10ms_h, category=SWHDR, domain=AUTOSAR}
        OsTask_event_c: artifact-descriptor={short-label=OsTask_event_c, category=SWSRC, domain=AUTOSAR}
        OsTask_event_h: artifact-descriptor={short-label=OsTask_event_h, category=SWHDR, domain=AUTOSAR}
        Rte_c: artifact-descriptor={short-label=Rte_c, category=SWSRC, domain=AUTOSAR}
        Rte_h: artifact-descriptor={short-label=Rte_h, category=SWHDR, domain=AUTOSAR}
        Rte_App_swc1_c: artifact-descriptor={short-label=Rte_App_swc1_c, category=SWSRC, domain=AUTOSAR}
        Rte_App_swc1_h: artifact-descriptor={short-label=Rte_App_swc1_h, category=SWHDR, domain=AUTOSAR}
        Rte_App_swc1_Type_h: artifact-descriptor={short-label=Rte_App_swc1_Type_h, category=SWHDR, domain=AUTOSAR}
        Rte_App_swc2_c: artifact-descriptor={short-label=Rte_App_swc2_c, category=SWSRC, domain=AUTOSAR}
        Rte_App_swc2_h: artifact-descriptor={short-label=Rte_App_swc2_h, category=SWHDR, domain=AUTOSAR}
        Rte_App_swc2_Type_h: artifact-descriptor={short-label=Rte_App_swc2_Type_h, category=SWHDR, domain=AUTOSAR}
        Rte_Cbk_h: artifact-descriptor={short-label=Rte_Cbk_h, category=SWHDR, domain=AUTOSAR}
        Rte_Cfg_h: artifact-descriptor={short-label=Rte_Cfg_h, category=SWHDR, domain=AUTOSAR}
        Rte_Const_h: artifact-descriptor={short-label=Rte_Const_h, category=SWHDR, domain=AUTOSAR}
        Rte_DataHandleType_h: artifact-descriptor={short-label=Rte_DataHandleType_h, category=SWHDR, domain=AUTOSAR}
        Rte_ECU_ABS_c: artifact-descriptor={short-label=Rte_ECU_ABS_c, category=SWSRC, domain=AUTOSAR}
        Rte_ECU_ABS_h: artifact-descriptor={short-label=Rte_ECU_ABS_h, category=SWHDR, domain=AUTOSAR}
        Rte_ECU_ABS_Type_h: artifact-descriptor={short-label=Rte_ECU_ABS_Type_h, category=SWHDR, domain=AUTOSAR}
        Rte_Hook_h: artifact-descriptor={short-label=Rte_Hook_h, category=SWHDR, domain=AUTOSAR}
        Rte_Intl_h: artifact-descriptor={short-label=Rte_Intl_h, category=SWHDR, domain=AUTOSAR}
        Rte_Lib_c: artifact-descriptor={short-label=Rte_Lib_c, category=SWSRC, domain=AUTOSAR}
        Rte_Main_h: artifact-descriptor={short-label=Rte_Main_h, category=SWHDR, domain=AUTOSAR}
        Rte_Sensor_swc_c: artifact-descriptor={short-label=Rte_Sensor_swc_c, category=SWSRC, domain=AUTOSAR}
        Rte_Sensor_swc_h: artifact-descriptor={short-label=Rte_Sensor_swc_h, category=SWHDR, domain=AUTOSAR}
        Rte_Sensor_swc_Type_h: artifact-descriptor={short-label=Rte_Sensor_swc_Type_h, category=SWHDR, domain=AUTOSAR}
        Rte_Type_h: artifact-descriptor={short-label=Rte_Type_h, category=SWHDR, domain=AUTOSAR}
    resource consumption ResConsumption
      5 x memory section:
        CODE: alignment=UNSPECIFIED, sw-addrmethod=CODE
        CONST_UNSPECIFIED: alignment=UNSPECIFIED, sw-addrmethod=CONST_UNSPECIFIED
        TASKBODY: alignment=UNSPECIFIED, sw-addrmethod=TASKBODY
        VAR_8BIT: alignment=8, sw-addrmethod=VAR_8BIT
        VAR_UNSPECIFIED: alignment=UNSPECIFIED, sw-addrmethod=VAR_UNSPECIFIED
package /AUTOSAR_Rte/DataConstrs
  range DataConstraints_DataConstr_uint8: phys 0..255, raw 0..255
package /AUTOSAR_Rte/ImplementationDataTypes
  10 x impl type:
    Rte_REActCounterType: category=VALUE  # This is an external type, i.e. it is declared in the Rte Library and not in the XML. RTEGen does not have any information about this type apart from its name.
    Rte_CDS_App_swc1: category=STRUCTURE
      element _dummy: implementation-data-type=uint8
    Rte_CDS_App_swc2: category=STRUCTURE
      element _dummy: implementation-data-type=uint8
    Rte_CDS_ECU_ABS: category=STRUCTURE
      element _dummy: implementation-data-type=uint8
    Rte_CDS_Sensor_swc: category=STRUCTURE
      element _dummy: implementation-data-type=uint8
    Rte_SelfType_App_swc1: implementation-data-type=Rte_CDS_App_swc1
    Rte_SelfType_App_swc2: implementation-data-type=Rte_CDS_App_swc2
    Rte_SelfType_ECU_ABS: implementation-data-type=Rte_CDS_ECU_ABS
    Rte_SelfType_Sensor_swc: implementation-data-type=Rte_CDS_Sensor_swc
    Rte_TaskInfo: category=VALUE  # This is an external type, i.e. it is declared in the Rte Library and not in the XML. RTEGen does not have any information about this type apart from its name.
package /AUTOSAR_Rte/SwAddrMethods
  5 x sw addr method:
    CODE: section-type=CODE
    CONST_UNSPECIFIED: section-type=CONST
    TASKBODY: section-type=CODE
    VAR_8BIT: section-type=VAR
    VAR_UNSPECIFIED: section-type=VAR
